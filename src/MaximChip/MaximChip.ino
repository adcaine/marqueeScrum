/**
Hookup guide to 5x7 LED matrix and arduino

Chip Pin    Corresponding 5x7 LED PIN or Arduino PIN  (5x7 unles otherwise stated)
1           Arduino Data Pin 2
2           13
3           6
4           GND
5           n/c
6           11 or 4
7           10
8           n/c
9           GND
10          n/c
11          3
12          Arduino Latch Pin 4

13          Arduino Lock Pin 3
14          14
15          2
16          8
17          n/c
18          5V through via 22K resister
19          5V
20          5 or 12
21          7
22          9
23          1
24          n/c
**/

#define DATA_PIN 2
#define LATCH_PIN 3
#define CLOCK_PIN 4

#define DECODE_MODE 0x09
#define INTENSITY_REGISTER 0x0A
#define SCAN_LIMIT 0x0B
#define SHUTDOWN_MODE 0x0C
#define TEST_MODE 0x0F


#define NUM_COLS 5


byte font_5x7[96][5] = {
        {0x00,0x00,0x00,0x00,0x00}, // blank
        {0x00,0x00,0xfa,0x00,0x00}, // !
        {0x00,0xe0,0x00,0xe0,0x00}, // "
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        {0x00,0x00,0x00,0x00,0x00}, //
};

void showCharacter(int character, int offest = 0);

void setup(){
  pinMode(DATA_PIN, OUTPUT);
  pinMode(CLOCK_PIN, OUTPUT);
  pinMode(LATCH_PIN, OUTPUT);
  digitalWrite(DATA_PIN, LOW);
  digitalWrite(CLOCK_PIN, LOW);
  digitalWrite(LATCH_PIN, LOW);
  setScanLimit(0x07);
  enableDecodeMode(false);
  enableNormalMode(true);
  enableTestMode(false);
  clearColumnRegisters();
  setIntensity(0x0A);
}

String message = "Time's up!  ";

void loop(){
  
  //printAMessage();
  //slide();
  printSlidingMessage();
}

void slide(){
  for(int i = 0; i < 90; i++){
    for(int offset = 0; offset < 5; offset++){
      showCharacter(i, offset);
      delay(50);
    }
  }
}

void printAMessage(){

  for(int i = 0; i < message.length(); i++){
    showCharacter(((byte)message[i]) - 32);
    delay(500);
    showCharacter(0);
    delay(200);
  }
  showCharacter(0);
  delay(500);

}

void printSlidingMessage(){
  byte frame[10];
  unsigned int currentCharacter = 0;
  unsigned int bufferStartingColumn = 0;
  for(unsigned int j = 0; j < 10; j++){
    frame[j] = 0x00;
  }
  showFrame(frame, bufferStartingColumn);
  while(true){
    for(unsigned int j = 0; j < NUM_COLS; j++){
      frame[bufferStartingColumn] = font_5x7[message[currentCharacter] - 32][j];
      bufferStartingColumn = ++bufferStartingColumn % 10;
      showFrame(frame, bufferStartingColumn);
      delay(50);
    }
  frame[bufferStartingColumn] = 0x00;
  bufferStartingColumn = ++bufferStartingColumn % 10;
  showFrame(frame, bufferStartingColumn);
  currentCharacter = (++currentCharacter) % message.length();
  } 
}


void shift16(byte opCode, byte data, boolean latch){
  digitalWrite(LATCH_PIN, LOW);
  shiftOut(DATA_PIN, CLOCK_PIN, MSBFIRST, opCode);
  shiftOut(DATA_PIN, CLOCK_PIN, MSBFIRST, data);
  if(latch){
    digitalWrite(LATCH_PIN, LOW);
    digitalWrite(LATCH_PIN, HIGH);
  }
}

void enableDecodeMode(boolean isDecodeMode){
  shift16(DECODE_MODE, isDecodeMode ? 0xFF : 0x00, false);
  shift16(DECODE_MODE, isDecodeMode ? 0xFF : 0x00, true);
}

void setScanLimit(byte limit){
  shift16(SCAN_LIMIT, limit, false);
  shift16(SCAN_LIMIT, limit, true);
}

void enableNormalMode(boolean isNormal){
  shift16(SHUTDOWN_MODE, isNormal ? 0x01 : 0x00, false);
  shift16(SHUTDOWN_MODE, isNormal ? 0x01 : 0x00, true);
}

void setIntensity(byte intensityValue){
  shift16(INTENSITY_REGISTER, intensityValue, false);
  shift16(INTENSITY_REGISTER, intensityValue, true);
}

void enableTestMode(boolean isTest){
  shift16(TEST_MODE, isTest ? 0x01 : 0x00, false);
  shift16(TEST_MODE, isTest ? 0x01 : 0x00, true);
}

void clearColumnRegisters(){
  for(byte col = 0x01; col < 0x09; col++){
    shift16(col, 0x00, false);
    shift16(col, 0x00, true);
  }
}

void showCharacter(int character, int offset){
  for(byte i=0; i < NUM_COLS; i++){
    shift16(i + 1, font_5x7[character][i + offset], true);
  }
}

void showFrame(byte cArray[], int startingColumn){
  unsigned int displayColumn = startingColumn;
  for(byte i=0; i < NUM_COLS; i++){
    shift16(i + 1, cArray[(displayColumn + 5) % 10], false);
    shift16(i + 1, cArray[(displayColumn) % 10], true);
    displayColumn = ++displayColumn % 10;
  }
}


